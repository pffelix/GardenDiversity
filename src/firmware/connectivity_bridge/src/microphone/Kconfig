## src/firmware/connectivity_bridge/src/microphone/Kconfig
```kconfig
#
# Copyright (c) 2020 Nordic Semiconductor
#
# SPDX-License-Identifier: LicenseRef-Nordic-5-Clause
#

if LOG

menu "Microphone options"

comment "Microphone selection"

config MODULE_MICROPHONE_PDM
	bool "Module PDM microphone"
	default y
	
config MODULE_MICROPHONE_SPI
	bool "Module SPI microphone"
	default y
	
endmenu

endif
```

## src/firmware/connectivity_bridge/src/uart/Kconfig
```kconfig
#
# Copyright (c) 2020 Nordic Semiconductor
#
# SPDX-License-Identifier: LicenseRef-Nordic-5-Clause
#

if LOG

menu "UART options"

comment "UART selection"

config MODULE_UART
	bool "Module UART"
	default y

endmenu

endif
```
