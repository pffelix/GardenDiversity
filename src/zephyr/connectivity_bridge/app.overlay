/*
 * Copyright (c) 2021 Nordic Semiconductor ASA
 *
 * SPDX-License-Identifier: Apache-2.0
 */

&zephyr_udc0 {
	cdc_acm_uart0 {
		compatible = "zephyr,cdc-acm-uart";
		label = "CDC_ACM_0";
	};

	cdc_acm_uart1 {
		compatible = "zephyr,cdc-acm-uart";
		label = "CDC_ACM_1";
	};
	
};

&spi3 {
	compatible = "nordic,nrf-spim";
	status = "okay";
	sck-pin = <6>;
	miso-pin = <5>;
	mosi-pin = <27>;
	cs-gpios = <&gpio0 26 0>;
};